## Kconfig
```kconfig
menu "Azure IoT Hub SDK"
    config AZURE_SDK_ENABLE_LOGGING
    bool "Enable Azure IoT SDK Logging functionalities"
    default y
    help
        Enable or disable all the logging functionalities for Azure IoT Hub SDK.
endmenu
```

## examples/azure_iot_pnp_sample/main/Kconfig.projbuild
```kconfig
menu "Example Configuration"

config WIFI_SSID
    string "WiFi SSID"
	default "myssid"
	help
		SSID (network name) for the example to connect to.

config WIFI_PASSWORD
    string "WiFi Password"
	default "myssid"
	help
		WiFi password (WPA or WPA2) for the example to use.

		Can be left blank if the network has no security set.

config DPS_ID_SCOPE
    string "Scope ID: A unique value used by the IoT Hub Device Provisioning Service"
    default "myidscope"
    help
        This is the unique ID scope of DPS, and can be found under "Overview"
        section of your DPS on azure IoT portal

config DEVICE_REGISTRATION_ID
    string "Device ID: Unique device identifier"
    default "mydeviceid"
    help
        Unique device identify

config DPS_SYMMETRIC_KEY
    string "Primary Key: Primary device SAS token"
    default "Symmetric key"
    help
        By default, the Device Provisioning Service creates the symmetric keys with a default length of 32 bytes.

endmenu
```

## examples/iothub_client_sample_mqtt/main/Kconfig.projbuild
```kconfig
menu "Example Configuration"

config WIFI_SSID
    string "WiFi SSID"
	default "myssid"
	help
		SSID (network name) for the example to connect to.

config WIFI_PASSWORD
    string "WiFi Password"
	default "myssid"
	help
		WiFi password (WPA or WPA2) for the example to use.

		Can be left blank if the network has no security set.

config IOTHUB_CONNECTION_STRING
    string "IOT Hub Device Connection String"
	default "HostName=<host_name>;DeviceId=<device_id>;SharedAccessKey=<device_key>"
	help
		String containing Hostname, Device Id & Device Key in the format:
		
		HostName=<host_name>;DeviceId=<device_id>;SharedAccessKey=<device_key>
		HostName=<host_name>;DeviceId=<device_id>;SharedAccessSignature=<device_sas_token>

		You can get this from the iothub-explorer CLI or the Azure Portal

config MESSAGE_INTERVAL_TIME
    int "Time delay in Milliseconds between two consecutive messages"
    default 100
    help
        Set time delay between two consecutive message sent to the cloud

config MESSAGE_COUNT
    int "Total number of messages to be sent to the cloud"
    default 50
    help
        This example will terminate after sending these many
        messages. If the message count is set as 0 then this example
        will send indefinite messages to the cloud.

endmenu
```

## examples/iothub_devicetwin_samples_and_methods/main/Kconfig.projbuild
```kconfig
menu "Example Configuration"

config WIFI_SSID
    string "WiFi SSID"
	default "myssid"
	help
		SSID (network name) for the example to connect to.

config WIFI_PASSWORD
    string "WiFi Password"
	default "myssid"
	help
		WiFi password (WPA or WPA2) for the example to use.

		Can be left blank if the network has no security set.

config IOTHUB_CONNECTION_STRING
    string "IOT Hub Device Connection String"
	default "HostName=<>;SharedAccessKeyName=<>;SharedAccessKey=<>"
    help
		String containing Hostname, SharedAccessKeyName & SharedAccessKey in the format:
		
		You can get this from the Azure IoT Portal

endmenu
```

## examples/iothub_devicetwin_samples_and_methods/sdkconfig.defaults
```kconfig
# newlib for ESP32 and ESP8266 platform

CONFIG_NEWLIB_ENABLE=y
CONFIG_NEWLIB_LIBRARY_LEVEL_NORMAL=y
CONFIG_NEWLIB_NANO_FORMAT=
CONFIG_SSL_USING_MBEDTLS=y
CONFIG_MBEDTLS_DYNAMIC_BUFFER=y
CONFIG_MBEDTLS_DYNAMIC_FREE_PEER_CERT=y
CONFIG_MBEDTLS_DYNAMIC_FREE_CONFIG_DATA=y
CONFIG_LWIP_IPV6=y

#
# FreeRTOS
#
CONFIG_FREERTOS_UNICORE=y
```

## examples/iothub_pnp_samples_temperature_controller/main/Kconfig.projbuild
```kconfig
menu "Example Configuration"

config WIFI_SSID
    string "WiFi SSID"
	default "myssid"
	help
		SSID (network name) for the example to connect to.

config WIFI_PASSWORD
    string "WiFi Password"
	default "myssid"
	help
		WiFi password (WPA or WPA2) for the example to use.

		Can be left blank if the network has no security set.

choice IOTHUB_AUTH_CHOOSE
        prompt "Choose Azure IoT Hub for authenticate (See help for more Info)"
        default IOTHUB_USING_DEVICE_KEY
        help
            The Azure IoT Hub support multiple authenticate. Currently Certificate and Symmetric Key are
            supported.
        config IOTHUB_USING_CERTIFICATE
            bool "Certificate"
        config IOTHUB_USING_DEVICE_KEY
            bool "Device Key"
endchoice

config IOTHUB_DPS_ENABLE
    bool "Azure IoT Device Provisioning Service function."
    default false
    help
        Enable the Azure IoT Hub Device Provisioning Service or Disable.

config IOTHUB_ENDPOINT
    string "IOT Hub Device End Point"
    default ""
    depends on IOTHUB_DPS_ENABLE
    help
        ENDPOINT, You can get this from the Azure IoT CLI or the Azure Portal.

config IOTHUB_REGISTRATION_ID
    string "Registration ID of Device"
    default ""
    depends on IOTHUB_DPS_ENABLE
    help
        Device Common name of Leaf Certificate when choose certificate authenticate.

config IOTHUB_ID_SCOPE
    string "ID Scope of Device provisioning Service"
    default ""
    depends on IOTHUB_DPS_ENABLE
    help
        This is the unique ID scope of Device Provisioning Service (DPS), and can be found under "Overview"
        section of your DPS on azure IoT portal

config IOTHUB_HOST_NAME
    string "IOT Hub Device Host Name"
	default ""
	help
        Device Host Name can be picked from device connection string which is of format: 
        HostName=<host_name>;DeviceId=<device_id>;SharedAccessKey=<device_key>
        You can get this from the Azure IoT CLI or the Azure Portal.

config IOTHUB_DEVICE_ID
    string "IOT Hub Device ID"
	default ""
	help
        Device ID can be picked from device connection string which is of format:
        HostName=<host_name>;DeviceId=<device_id>;SharedAccessKey=<device_key>
        You can get this from the Azure IoT CLI or the Azure Portal.

config IOTHUB_DEVICE_KEY
    string "IOT Hub Device Key"
    depends on IOTHUB_USING_DEVICE_KEY
    default ""
	help
        Device key can be picked from device connection string which is of format: 
        HostName=<host_name>;DeviceId=<device_id>;SharedAccessKey=<device_key>
        You can get this from the Azure IoT CLI or the Azure Portal.

config IOTHUB_MODULE_ID
            string "IOT Hub Device Module ID"
            default ""
            help
                Module ID which define the device capabilities, You can get this from the https://devicemodels.azureiotsolutions.com.

config IOTHUB_PROPERTY
            bool "IOT Hub Device Property"
            default n
            help
                Enable or Disable the device's properties when send to or receive from cloud.

config IOTHUB_WAIT_OPTION
        int "Time wait in Milliseconds between two consecutive messages"
        range   100 65536
        default 100
        help
            Set time delay between two consecutive message receive from the cloud.

endmenu
```

## examples/prov_dev_client_ll_sample/main/Kconfig.projbuild
```kconfig
menu "Example Configuration"

config WIFI_SSID
    string "WiFi SSID"
	default "myssid"
	help
		SSID (network name) for the example to connect to.

config WIFI_PASSWORD
    string "WiFi Password"
	default "myssid"
	help
		WiFi password (WPA or WPA2) for the example to use.

		Can be left blank if the network has no security set.

config IOTHUB_CONNECTION_STRING
    string "IOT Hub Connection String"
	default ""
	help
		The IoT Hub Connection string - primary key in the format
		"HostName=<hostname>;SharedAccessKeyName=<shared_access_key_name>;SharedAccessKey=<shared_access_key>."
		You can get this from the Azure IoT CLI or the Azure Portal.

config DEVICE_COMMON_NAME
    string "Device Leaf Certificate Common Name"
    default "mydevice"
    help
        Common name of Leaf Certificate

config DPS_ID_SCOPE
    string "ID Scope of Device provisioning service"
    default "myidscope"
    help
        This is the unique ID scope of Device Provisioning Service (DPS), and can be found under "Overview"
        section of your DPS on azure IoT portal

endmenu
```

## examples/prov_dev_client_ll_sample_symm_keys/main/Kconfig.projbuild
```kconfig
menu "Example Configuration"

config WIFI_SSID
    string "WiFi SSID"
	default "myssid"
	help
		SSID (network name) for the example to connect to.

config WIFI_PASSWORD
    string "WiFi Password"
	default "myssid"
	help
		WiFi password (WPA or WPA2) for the example to use.

		Can be left blank if the network has no security set.

config SYMM_KEY
         string "Symmetric key"
    	 default "key"
    	 help
		Symmetric key, which will be used for the device

config REGISTRATION_ID
         string "Device registration ID"
    	 default "reg-id"
    	 help
		Device registration ID to be used for registration through Device Provisioning Service

config DPS_ID_SCOPE
    string "ID Scope of Device provisioning service"
    default "myidscope"
    help
        This is the unique ID scope of Device Provisioning Service (DPS), and can be found under "Overview"
        section of your DPS on azure IoT portal

endmenu
```
